## samples/buck/Kconfig
```kconfig
#
# Copyright (c) 2022 Nordic Semiconductor ASA
#
# SPDX-License-Identifier: Apache-2.0
#

mainmenu "PMIC example: Buck"

choice
	bool "Testcase selection"
	default TESTCASE_SET_BUCK_VOLTAGE

config TESTCASE_SET_BUCK_VOLTAGE
	bool "Set output voltage of both bucks (simple)"

config TESTCASE_OUTPUT_VOLTAGE
	bool "Set output voltage of both bucks (advanced)"

config TESTCASE_RETENTION_VOLTAGE
	bool "Set retention voltage of buck 1 with selected external pin"

config TESTCASE_ENABLE_BUCKS_USING_PIN
	bool "Set enable mode of buck 1 with selected external pin"

endchoice

source "Kconfig.zephyr"
```

## west.yml
```yaml
# The west manifest file (west.yml) for npmx-zephyr.

manifest:
  defaults:
    remote: NordicSemiconductor

  remotes:
    - name: NordicSemiconductor
      url-base: https://github.com/NordicSemiconductor
    - name: zephyrproject
      url-base: https://github.com/zephyrproject-rtos
    - name: nrfconnect
      url-base: https://github.com/nrfconnect

  projects:
    - name: zephyr
      remote: zephyrproject
      revision: v3.3.0
      import: true
    - name: npmx
      revision: v0.6.0
      path: modules/npmx
    - name: sdk-nrfxlib
      remote: nrfconnect
      revision: v2.4.0-rc1
      path: modules/nrfxlib
```
