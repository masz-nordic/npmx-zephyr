## CMakeLists.txt
```
#
# Copyright (c) 2023 Nordic Semiconductor ASA
#
# SPDX-License-Identifier: Apache-2.0
#

cmake_minimum_required(VERSION 3.20.0)
find_package(Zephyr REQUIRED HINTS $ENV{ZEPHYR_BASE})
project(pmic_shell_example)

FILE(GLOB app_sources src/*.c)
target_sources(app PRIVATE ${app_sources})
```

## sample.yaml
```
sample:
  description: Sample for nPM1300 PMIC SHELL
  name: nPM1300 PMIC SHELL

common:
    tags: pmic
    timeout: 30

tests:
  sample.pmic.shell_example_eng_b:
    integration_platforms:
      - nrf5340dk_nrf5340_cpuapp
      - nrf52840dk_nrf52840
    platform_allow: nrf5340dk_nrf5340_cpuapp nrf52840dk_nrf52840
    extra_args: CONFIG_NPMX_DEVICE_NPM1300_ENG_B=y
    harness: console
    harness_config:
      fixture: nPM1300_setup_eng_b
      type: multi_line
      ordered: false
      regex:
        -  "PMIC device ok"
```

## prj.conf
```kconfig
#
# Copyright (c) 2023 Nordic Semiconductor ASA
#
# SPDX-License-Identifier: Apache-2.0
#

CONFIG_SERIAL=y
CONFIG_CONSOLE=y
CONFIG_UART_CONSOLE=y

CONFIG_I2C=y
CONFIG_NPMX=y
CONFIG_NPMX_DEVICE_NPM1300_ENG_B=y
CONFIG_LOG=y
CONFIG_NPMX_LOG_LEVEL_DBG=y

# shell configuration
CONFIG_SHELL=y
CONFIG_SHELL_BACKENDS=y
CONFIG_SHELL_BACKEND_SERIAL=y
CONFIG_NPMX_SHELL=y
CONFIG_ASSERT=y

# Core Dump configuraion
CONFIG_DEBUG_COREDUMP=y
CONFIG_DEBUG_COREDUMP_BACKEND_LOGGING=y
```

## src/main.c
```c
/*
 * Copyright (c) 2023 Nordic Semiconductor ASA
 *
 * SPDX-License-Identifier: Apache-2.0
 */

#include <zephyr/logging/log.h>
#include <zephyr/kernel.h>
#include <npmx_driver.h>

#define LOG_MODULE_NAME pmic_shell_example
LOG_MODULE_REGISTER(LOG_MODULE_NAME);

static void pof_callback(npmx_instance_t *instance)
{
	LOG_INF("POF callback");
}

void main(void)
{
	const struct device *pmic_dev = DEVICE_DT_GET(DT_NODELABEL(npm_0));

	if (!device_is_ready(pmic_dev)) {
		LOG_INF("PMIC device is not ready");
		return;
	}

	LOG_INF("PMIC device ok");

	npmx_instance_t *npmx_instance = npmx_driver_instance_get(pmic_dev);

	npmx_ldsw_active_discharge_enable_set(npmx_ldsw_get(npmx_instance, 0), true);
	npmx_ldsw_active_discharge_enable_set(npmx_ldsw_get(npmx_instance, 1), true);

	/* Register callback so that POF warnings can be printed. */
	npmx_pof_config_t pof_config = { .status = NPMX_POF_STATUS_ENABLE,
					 .threshold = NPMX_POF_THRESHOLD_3V5,
					 .polarity = NPMX_POF_POLARITY_HIGH };

	npmx_driver_register_pof_cb(pmic_dev, &pof_config, pof_callback);

	while (1) {
		k_sleep(K_FOREVER);
	}
}
```
